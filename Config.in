## Config.in
```kconfig
config BR2_PACKAGE_LIBRETRO_VICE
        bool "libretro-vice"
	depends on BR2_PACKAGE_RETROARCH
	depends on BR2_INSTALL_LIBSTDCPP
        help
          A libretro libretro-vice emulator core for ARM.

	  http://www.libretro.com

comment "LIBRETRO_VICE needs a toolchain w/ C++"
	depends on !BR2_INSTALL_LIBSTDCPP
```
